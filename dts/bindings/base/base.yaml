## dts/bindings/base/base.yaml
```yaml
# Common fields for all devices

include: pm.yaml

properties:
  compatible:
    type: string-array
    required: true
    description: |
      The compatible property value consists of one or more strings that define
      the specific programming model for the device. In Zephyr this list of
      strings will be used for device driver and devicetree binding file
      selection.

      The property value consists of a concatenated list of strings, from most
      specific to most general. In the context of a device node this allows a
      device to express its compatibility with a family of similar devices,
      potentially allowing a single device driver to match against several
      devices.

      The recommended format is "manufacturer,model", where manufacturer is a
      string describing the name of the manufacturer (such as a stock ticker
      symbol), and model specifies the model number. The compatible string SHALL
      consist only of lowercase letters, digits and dashes, and SHALL start with
      a letter. A single comma MAY only be used following a vendor prefix.
      Underscores SHALL not be used.

      Note: These are SHOULD-requirements in the original specifications but in
      Zephyr they were upgraded to SHALL-requirements.

      Example:
        `compatible = "fsl,mpc8641", "ns16550";`

      In this example, Zephyr would first try to locate a device driver that
      supported fsl,mpc8641. If a driver was not found, it would then try to
      locate a driver that supported the more general ns16550 device type.

      Note: You can search for compatible drivers in the tree by replacing any
      non-alphanumeric character (namely commas and dashes) of a compatible
      string by an underscore (`_`) combined with the macro `DT_DRV_COMPAT`.

      Example:
        `DT_DRV_COMPAT fsl_mpc8641`

      You can locate corresponding binding files, by searching for *.y[a]ml
      files including one of the compatible strings with a colon rather than an
      equality sign.

      Example:
        `compatible: "fsl,mpc8641"`

  status:
    type: string
    description: |
      In the context of a device node:

        Zephyr's use of the status property in the context of a device node
        deviates slightly from the semantics defined in the devicetree standard.

        Rather than representing an operational state, it configures application
        specific driver instantiation requirements: A value of "okay" indicates
        that a device driver SHALL be instantiated and initialized for this
        device at boot time, i.e. it is intended that the driver instance be
        "ready" at the time `main()` is called.

        A device driver can only be instantiated if exactly one driver is
        included in the build that binds to the compatible value of the device.
        This is usually done by setting a corresponding Kconfig variable like
        `CONFIG_ADC=y`.

        A value of "disabled" indicates that a device driver SHALL not be
        instantiated for this device. This is useful for devices that are not
        used by the application to reduce the memory footprint of the build.

        Other values are included for compatibility with the devicetree
        specification but are not used by Zephyr.

      In the context of a non-device node:

        A value of "disabled" indicates that the configuration (including all
        subnodes) SHALL be disregarded as if it was not part of the tree. A
        value of "okay" indicates that the configuration SHALL be used.

      Note: By the devicetree specification, the lack of a status property will
      be treated as if the property existed with the value of "okay".

      Note: Using "ok" instead of "okay" is deprecated.
    enum:
      - "ok" # deprecated
      - "okay"
      - "disabled"
      - "reserved"
      - "fail"
      - "fail-sss"

  reg:
    type: array
    description: register space

  reg-names:
    type: string-array
    description: name of each register space

  "#address-cells":
    type: int
    description: number of address cells in reg property

  "#size-cells":
    type: int
    description: number of size cells in reg property

  interrupts:
    type: array
    description: interrupts for device

  # Does not follow the 'type: phandle-array' scheme, but gets type-checked
  # by the code. Declare it here just so that other bindings can make it
  # 'required: true' easily if they want to.
  interrupts-extended:
    type: compound
    description: extended interrupt specifier for device

  interrupt-names:
    type: string-array
    description: name of each interrupt

  interrupt-parent:
    type: phandle
    description: phandle to interrupt controller node

  label:
    type: string
    deprecated: true
    description: |
      Human readable string describing the device (used as device_get_binding() argument)

  clocks:
    type: phandle-array
    description: Clock gate information

  clock-names:
    type: string-array
    description: name of each clock

  dmas:
    type: phandle-array
    description: DMA channels specifiers

  dma-names:
    type: string-array
    description: Provided names of DMA channel specifiers

  io-channels:
    type: phandle-array
    description: IO channels specifiers

  io-channel-names:
    type: string-array
    description: Provided names of IO channel specifiers

  mboxes:
    type: phandle-array
    description: mailbox / IPM channels specifiers
    specifier-space: mbox

  mbox-names:
    type: string-array
    description: Provided names of mailbox / IPM channel specifiers

  power-domains:
    type: phandle-array
    description: Power domain specifiers

  power-domain-names:
    type: string-array
    description: Provided names of power domain specifiers

  "#power-domain-cells":
    type: int
    description: Number of cells in power-domains property

  zephyr,deferred-init:
    type: boolean
    description: |
      Do not initialize device automatically on boot. Device should be manually
      initialized using device_init().
```

## dts/bindings/net/wireless/ti,cc13xx-cc26xx-radio.yaml
```yaml
# Copyright (c) 2022 Nordic Semiconductor ASA
# SPDX-License-Identifier: Apache-2.0

description: TI SimpleLink CC13xx / CC26xx radio node

compatible: "ti,cc13xx-cc26xx-radio"

include: [pinctrl-device.yaml, base.yaml]

properties:
  reg:
    required: true

  debug-pins:
    type: string
    description: |
      Indicates the radio debug level to be enabled:
        - off: The radio debug pins will be put in a passive state (high z).
        - rx: The configured radio RX debug pin will indicate RX slots.
        - tx: The configured radio TX debug pin will indicate outgoing TX
              packets.
        - all: The debug pins will indicate both, RX and TX activity.
    enum:
      - "off"
      - "rx"
      - "tx"
      - "all"
```

## dts/bindings/subsys/net/l2/ieee802154/zephyr,net-l2-ieee802154.yaml
```yaml
# SPDX-License-Identifier: Apache-2.0

description: |
  Generic IEEE 802.15.4 MAC configuration shared by all IEEE 802.15.4 L2
  implementations.

  Note: Please do not add PHY-specific properties to this binding file.
  Currently we do not support IEEE 802.15.4 PHY-specific configuration. Once
  drivers appear that require PHY-specific configuration, we will add
  corresponding subnode bindings for each supported channel page.

  All nodes using this binding SHALL be called "ieee802154" and SHALL be placed
  inside the corresponding "iface" node.

  Existing "ieee802154[g]" nodes placed directly below a radio peripheral will
  continue to be supported but are deprecated. IEEE 802.15.4 interface drivers
  will consider both locations and merge the result.

  Matching IEEE 802.15.4 interface drivers SHALL be derived from the compatible
  string at the radio device peripheral level further up in the tree hierarchy.
  Drivers matched at the "ieee802154[g]" node level will continue to be
  supported but are deprecated.

  If multiple interface drivers exists for a given radio periopheral then the
  proper driver (e.g. SubG vs. 2.4G) SHALL be specified by corresponding Kconfig
  options as is the case for other driver subsystems. And also as with other
  drivers: At most one driver within a build SHALL match the radio peripheral's
  compatible at the same time.

  References are to the IEEE 802.15.4-2020 standard by default.

compatible: "zephyr,net-l2-ieee802154"

include: node.yaml

properties:
  pan-id:
    type: int
    description: The IEEE 802.15.4 PAN ID, e.g. 0xabcd (CPU encoding).
    required: true

  ext-addr:
    type: uint8-array
    description: |
      The IEEE 802.15.4 extended address (big endian),
      e.g. [c2 a3 9e 00 00 4b 12 00].
    required: true

  default-channel-page:
    type: int
    description: |
      The IEEE 802.15.4 default channel page (see phyCurrentPage, section 11.3,
      table 11-2), e.g. 0. Allowable values depend on the channel pages
      supported by the selected driver.

      Note that the channel attribute is PHY independent although it belongs to
      the PHY layer. That's why it is specified here.
    default: 0

  default-channel:
    type: int
    description: |
      The IEEE 802.15.4 default channel (see phyCurrentChannel, section 11.3,
      table 11-2), e.g. 26. Allowable values depend on the channel page
      supported by the selected driver.

      For the deprecated legacy channel page zero (which is what most Zephyr
      drivers currently support), channels 0-10 are in the Sub-GHz band and
      channels 11-26 are in the 2.4 GHz band.

      Note that the channel attribute is PHY independent although it belongs to
      the PHY layer. That's why it is specified here.
    default: 11

  default-tx-pwr: # Should probably be moved to the radio peripheral level as it has nothing to do with IEEE 802.15.4.
    type: int # if negative values are not yet supported, this should be fixed
    description: |
      The default TX power in dB, e.g. -5, 0 or 3. Allowable values are driver
      specific.

      Note that TX power is not specified in the standard but is an attribute
      commonly used by Zephyr drivers That's why it is specified here.
    default: 0
```

## dts/bindings/subsys/net/lib/sntp/zephyr,net-lib-sntp-servers.yaml
```yaml
# SPDX-License-Identifier: Apache-2.0

include: node.yaml

description: |
  The SNTP library is part of the network subsystem. SNTP servers can be
  configured using this binding. To use an SNTP server in your network
  configuration, refer to it with a phandle.

  Nodes using this binding SHALL be called "sntp-servers".

compatible: "zephyr,net-lib-sntp-servers"

properties:
  "#address-cells":
    const: 1

  "#size-cells":
    const: 0

child-binding:
  description: |
    SNTP server configuration.

    SNTP server configuration nodes SHALL be named according to the pattern
    "sntp-server@<int>". The address part of the node is used to identify the
    SNTP server instance and does not have other meaning.

  properties:
    reg:
      type: array
      required: true
      description: SNTP server identifier

    server-name:
      type: string
      required: true
      description: The NTP clock source, e.g. "time.google.com".

    timeout:
      type: int
      description: The NTP server timeout in seconds.
      default: 30
```

## dts/bindings/subsys/net/zephyr,net-iface.yaml
```yaml
# SPDX-License-Identifier: Apache-2.0

include: node.yaml

description: |
  Network interface configuration.

  All nodes using this binding SHOULD be called "iface" or "iface@<u32>". At
  build time, devicetree nodes representing a network device MAY have exactly as
  many "iface[@<u32>]" child nodes with "status = 'okay'" as the corresponding
  device node instantiates network interfaces. In most cases this will be a
  single network interface per device node in which case the address part of the
  "iface" node is optional.

  If a single devicetree node instantiates more than one network interface, then
  the "iface" nodes SHOULD be named "iface@0", "iface@1", etc.

  Note: The interface node's address part has no semantic meaning other than
  uniquely identifying instances of interface nodes. Notably the address part
  does not correspond to the interface index.

compatible: "zephyr,net-iface"

properties:
  set-iface-name:
    type: string
    description: Sets a non-default interface name. If not set, the interface
      name will be the interface's device name.

  is-default:
    type: boolean
    description: If set, this interface will be the default interface.

  set-flags:
    type: int
    description: |
      A bitmask of network interface flags that shall be added to this
      interface. See the ``net_if_flag`` documentation for details of the flags.

      The following flags can be set or cleared:
      ``NET_IF_POINTOPOINT``, ``NET_IF_PROMISC``, ``NET_IF_NO_AUTO_START``,
      ``NET_IF_FORWARD_MULTICASTS``, ``NET_IF_IPV6_NO_ND``,
      ``NET_IF_IPV6_NO_MLD``

      Your configuration needs to include
      <zephyr/dt-bindings/subsys/net/if_flags.h> if you use this property.
    default: 0

  clear-flags:
    type: int
    description: |
      A bitmask of network interface flags that shall be removed from this
      interface. See the ``net_if_flag`` documentation for details of the flags.
      See the set-flags property description for flags that can be cleared.
    default: 0

  sntp-server:
    type: phandle
    description: |
      Reference to an SNTP server configuration
```

## dts/bindings/subsys/net/zephyr,net-ipv4-dhcp-server.yaml
```yaml
# SPDX-License-Identifier: Apache-2.0

description: |
  IPv4 DHCP server configuration.

  All nodes using this binding SHALL be called "dhcp-server" and SHALL be placed
  inside the corresponding "ipv4" node.

compatible: "zephyr,net-ipv4-dhcp-server"

include: node.yaml

properties:
  base-addr:
    type: string
    description: |
      Start address of the DHCP server pool optionally including
      subnet mask bits, e.g. "192.168.1.100/24".
    required: true
```

## dts/bindings/subsys/net/zephyr,net-ipv6-dhcp-client.yaml
```yaml
# SPDX-License-Identifier: Apache-2.0

description: |
  IPv6 DHCP client configuration.

  All nodes using this binding SHALL be called "dhcp-client" and SHALL be placed
  inside the corresponding "ipv6" node.

compatible: "zephyr,net-ipv6-dhcp-client"

include: node.yaml

properties:
  req-addr:
    type: boolean
    description: Whether to request an address from the DHCP server.

  req-prefix:
    type: boolean
    description: Whether to request a prefix from the DHCP server.
```

## dts/bindings/subsys/net/zephyr,net-ipv6-prefixes.yaml
```yaml
# SPDX-License-Identifier: Apache-2.0

description: |
  IPv6 prefix configuration.

  All nodes using this binding SHALL be called "prefixes" and placed inside an
  "ipv6" node.

compatible: "zephyr,net-ipv6-prefixes"

include: node.yaml

properties:
  "#address-cells":
    const: 1

  "#size-cells":
    const: 0

child-binding:
  description: |
    Prefix configuration.

    IPv6 prefix nodes SHALL be named according to the pattern "prefix@<int>". The
    address part of the node is used to identify the prefix instance and does not
    have any other semantic meaning.

  properties:
    reg:
      type: array
      required: true
      description: prefix identifier

    addr:
      type: string
      required: true
      description: IPv6 prefix, e.g. "2001:db8::".

    len:
      type: int
      default: 64
      description: prefix length (in bits)

    lifetime:
      type: int
      required: true
      description: prefix lifetime in seconds
```
