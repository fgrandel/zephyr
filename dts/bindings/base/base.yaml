## dts/bindings/subsys/net/zephyr,net-ipv6.yaml
```yaml
# SPDX-License-Identifier: Apache-2.0

description: |
  IPv6 configuration.

  All nodes using this binding SHALL be called "ipv6" and SHALL be placed inside
  the corresponding "iface" node.

compatible: "zephyr,net-ipv6"

include: node.yaml

properties:
  addrs:
    type: string-array
    description: |
      One or more statically configured IPv6 addresses, e.g. "2001:db8:110::1".

  hop-limit:
    type: int
    description: IPv6 hop limit.
    default: 64

  mcast-addrs:
    type: string-array
    description: List of IPv6 multicast addresses, e.g. "ff05::114", "ff15::115".

  mcast-hop-limit:
    type: int
    description: IPv6 multicast hop limit.
    default: 1
```

## dts/bindings/subsys/net/zephyr,net-vlan.yaml
```yaml
# SPDX-License-Identifier: Apache-2.0

description: |
  VLAN configuration.

  All nodes using this binding SHALL be called "vlan" and SHALL be placed inside
  the corresponding "iface" node.

compatible: "zephyr,net-vlan"

include: node.yaml

properties:
  tag:
    type: int
    description: VLAN tag, e.g. "100".
    required: true

  iface-name:
    type: string
    description: Sets a non-default interface name for the VLAN.
```

## dts/bindings/zephyr,sample-settings.yaml
```yaml
# SPDX-License-Identifier: Apache-2.0

include: node.yaml

description: |
  Settings Sample Configuration

compatible: "zephyr,sample-settings"

properties:
  gamma:
    type: int

child-binding:
  properties:
    '1':
      type: int
    '2':
      type: int
    voltage:
      type: int
    source:
      type: string
```

## samples/boards/nordic/clock_control/sample.yaml
```yaml
sample:
  name: Clock control sample
common:
  platform_allow:
    - nrf54h20dk/nrf54h20/cpuapp
  harness: console
  harness_config:
    type: one_line
    regex:
      - "clock spec request released"
tests:
  sample.boards.nrf.clock_control.fll16m:
    filter: dt_nodelabel_enabled("fll16m")
    extra_args:
      - CONF_FILE="configs/fll16m.conf"
      - SETTINGS_OVERLAY_FILES="configs/fll16m.overlay"
  sample.boards.nrf.clock_control.lfclk:
    filter: dt_nodelabel_enabled("lfclk")
    extra_args:
      - CONF_FILE="configs/lfclk.conf"
      - SETTINGS_OVERLAY_FILES="configs/lfclk.overlay"
  sample.boards.nrf.clock_control.uart135:
    filter: dt_nodelabel_enabled("uart135")
    extra_args:
      - CONF_FILE="configs/uart135.conf"
      - SETTINGS_OVERLAY_FILES="configs/uart135.overlay"
  sample.boards.nrf.clock_control.cpuapp_hsfll:
    filter: dt_nodelabel_enabled("cpuapp_hsfll")
    extra_args:
      - CONF_FILE="configs/cpuapp_hsfll.conf"
      - SETTINGS_OVERLAY_FILES="configs/cpuapp_hsfll.overlay"
```

## subsys/net/l2/ieee802154/Kconfig
```kconfig
# Copyright (c) 2016 Intel Corporation.
# SPDX-License-Identifier: Apache-2.0

menuconfig NET_L2_IEEE802154
	bool "IEEE 802.15.4 Radio"
	select NET_L2_PHY_IEEE802154
	help
	  Add support for low rate WPAN IEEE 802.15.4 technology.

if NET_L2_IEEE802154

config NET_L2_IEEE802154_MGMT
	bool
	select NET_MGMT
	select NET_MGMT_EVENT

# Virtual configuration option that can be chosen by features that require
# IEEE 802.15.4-2015+ information element (IE) parsing or writing.
config NET_L2_IEEE802154_IE_SUPPORT
	bool

# Virtual configuration option that can be chosen by features that require
# IEEE 802.15.4-2015+ channel hopping.
config NET_L2_IEEE802154_CHANNEL_HOPPING_SUPPORT
	bool

module = NET_L2_IEEE802154
module-dep = NET_LOG
module-str = Log level for IEEE 802.15.4
module-help = Enables IEEE 802.15.4 code to output debug messages.
source "subsys/net/Kconfig.template.log_config.net"

config NET_DEBUG_L2_IEEE802154_DISPLAY_PACKET
	bool "IEEE 802.15.4 packet display"
	depends on NET_LOG
	help
	  Enable printing out in/out 802.15.4 packets. This is extremely
	  verbose, do not enable this unless you know what you are doing.

choice
	prompt "Which packet do you want to print-out?"
	default NET_DEBUG_L2_IEEE802154_DISPLAY_PACKET_FULL
	depends on NET_DEBUG_L2_IEEE802154_DISPLAY_PACKET

config NET_DEBUG_L2_IEEE802154_DISPLAY_PACKET_FULL
	bool "Print-out both RX and TX packets"
	help
	  This will print-out both received and transmitted packets.

config NET_DEBUG_L2_IEEE802154_DISPLAY_PACKET_RX
	bool "Print-out only RX packets"
	help
	  This will print-out received packets only.

config NET_DEBUG_L2_IEEE802154_DISPLAY_PACKET_TX
	bool "Print-out only TX packets"
	help
	  This will print-out transmitted packets only.

endchoice

config NET_L2_IEEE802154_IMPLICIT_BROADCAST
	bool "IEEE 802.15.4 implicit broadcast"
	default y
	help
	  Indicates whether frames without a destination PAN ID and a destination
	  address are to be treated as though they are addressed to the broadcast
	  PAN ID and broadcast short address (MAC PIB attribute: macImplicitBroadcast).
	  Deviating from the standard implicit broadcasts are accepted by default
	  to maintain backwards compatibility.

config NET_L2_IEEE802154_ACK_REPLY
	bool
	select DEPRECATED

choice
	prompt "Device feature level"
	default NET_L2_IEEE802154_RFD
	help
	  Select the IEEE 802.15.4 device feature level.

config NET_L2_IEEE802154_RFD
	bool "Reduced Functionality Device (RFD)"
	help
	  This is the level for an IEEE 802.15.4 end device with minimal
	  resources that is neither a coordinator nor a PAN coordinator. This
	  device profile only supports features required by all IEEE 802.15.4
	  devices such as doing active or passive network scans, as well as
	  associating and disassociating to/from a PAN.

config NET_L2_IEEE802154_FFD
	bool "Full Functionality Device (FFD) [EXPERIMENTAL]"
	select EXPERIMENTAL
	help
	  This is the feature level required for a coordinator or PAN
	  coordinator. A PAN coordinator is allowed to start a network and
	  define network parameters. Both, coordinators and PAN coordinators may
	  associate other devices and distribute short device addresses. Not all
	  FFD features are implemented yet, therefore this option is
	  EXPERIMENTAL.
endchoice

config NET_L2_IEEE802154_SHELL
	bool "IEEE 802.15.4 shell module"
	select SHELL
	select NET_L2_IEEE802154_MGMT
	help
	  This can be used for testing 15.4 through the console via exposing
	  a shell module named "ieee15_4".

config NET_L2_IEEE802154_FRAGMENT
	bool "802.15.4 fragmentation support"
	default y
	depends on NET_6LO
	help
	  If IPv6 packets size more than 802.15.4 MTU, packet is fragmented
	  and reassemble incoming packets according to RFC4944/6282.

if NET_L2_IEEE802154_FRAGMENT

config NET_L2_IEEE802154_FRAGMENT_REASS_CACHE_SIZE
	int "IEEE 802.15.4 Reassembly cache size"
	default 1
	help
	  Simultaneously reassemble 802.15.4 fragments depending on
	  cache size.

config NET_L2_IEEE802154_REASSEMBLY_TIMEOUT
	int "IEEE 802.15.4 Reassembly timeout in seconds"
	default 5
	range 1 60
	help
	  Reassembly timer will start as soon as first packet received
	  from peer. Reassembly should be finished within a given time.
	  Otherwise all accumulated fragments are dropped.

endif # NET_L2_IEEE802154_FRAGMENT

config NET_L2_IEEE802154_SECURITY
	bool "IEEE 802.15.4 security [EXPERIMENTAL]"
	select EXPERIMENTAL
	help
	  Enable 802.15.4 frame security handling, in order to bring data
	  confidentiality and authenticity. The implementation is incomplete
	  (only implicit key mode, no key/device specific state, incoming
	  and outgoing security procedures only partially implemented, etc.).
	  Therefore the feature is to be considered EXPERIMENTAL work in
	  progress.

config NET_L2_IEEE802154_SECURITY_CRYPTO_DEV_NAME
	string "Crypto device name used for <en/de>cryption"
	default ""
	depends on NET_L2_IEEE802154_SECURITY
	help
	  This option should be used to set the crypto device name that
	  IEEE 802.15.4 soft MAC will use to run authentication, encryption and
	  decryption operations on incoming/outgoing frames.

if NET_L2_IEEE802154_IE_SUPPORT
config NET_L2_IEEE802154_TSCH_MAX_ADV_SLOTFRAMES
	int "Maximum number of advertised slotframes that can be received"
	range 1 255
	default 1
	help
	  Defines the maximum number of slotframes that can be received in a
	  beacon from another coordinator.
endif

config NET_L2_IEEE802154_TSCH
	bool "Start the IEEE 802.15.4 L2 in TSCH mode [EXPERIMENTAL]"
	select EXPERIMENTAL
	depends on NET_TIME_REFERENCE_CLOCK
	select NET_L2_IEEE802154_IE_SUPPORT
	select NET_L2_IEEE802154_CHANNEL_HOPPING_SUPPORT
	select NET_PKT_TXTIME
	# requires macTimestampSupported,
	# see IEEE 802.15.4-2020, section 6.5.4.3
	select NET_PKT_TIMESTAMP
	help
	  Start the 802.15.4 L2 driver in TSCH (time slotted channel hopping)
	  mode (MAC PIB attribute: macTschEnabled). This is EXPERIMENTAL work
	  in progress.

if NET_L2_IEEE802154_TSCH

config NET_L2_IEEE802154_TSCH_STACK_SIZE
	int "IEEE 802.15.4 TSCH operation stack size"
	default 800
	help
	  Sets the stack size of the thread operating TSCH slotframes.

config NET_L2_IEEE802154_MAX_NEIGHBORS
	int "The maximum number of neighbors reachable from a IEEE 802.15.4 node"
	default 8
	range 1 254
	help
	  The value depends on your network needs. Currently only the TSCH
	  protocol stores per-neighbour information.

endif # NET_L2_IEEE802154_TSCH

# Hidden option enabled when an IEEE 802.15.4 neighbour cache is required.
config NET_L2_IEEE802154_NBR_CACHE
	bool
	default y if NET_L2_IEEE802154_TSCH

source "subsys/net/l2/ieee802154/Kconfig.radio"

endif
```

## tests/bluetooth/addr/testcase.yaml
```yaml
tests:
  bluetooth.addr:
    extra_args:
      - EXTRA_SETTINGS_OVERLAY_FILES="test.overlay"
    platform_allow:
      - native_sim
      - native_sim/native/64
      - qemu_x86
      - qemu_cortex_m3
    tags:
      - bluetooth
      - addr
    integration_platforms:
      - native_sim
```

## tests/bluetooth/bluetooth/testcase.yaml
```yaml
tests:
  bluetooth.general:
    extra_args:
      - EXTRA_SETTINGS_OVERLAY_FILES="test.overlay"
    platform_allow:
      - qemu_x86
      - qemu_cortex_m3
      - native_sim
      - native_sim/native/64
    integration_platforms:
      - qemu_x86
    tags: bluetooth
```

## tests/bluetooth/hci_prop_evt/testcase.yaml
```yaml
tests:
  bluetooth.hci_prop_evt:
    extra_args:
      - EXTRA_SETTINGS_OVERLAY_FILES="test.overlay"
    platform_allow:
      - qemu_x86
      - qemu_cortex_m3
      - native_sim
      - native_sim/native/64
    integration_platforms:
      - native_sim
    tags:
      - bluetooth
      - hci
      - prop
      - event
```

## tests/bluetooth/hci_uart_async/testcase.yaml
```yaml
tests:
  bluetooth.hci_uart_async:
    extra_args:
      - EXTRA_SETTINGS_OVERLAY_FILES="test.overlay"
    tags:
      - bluetooth
      - uart
    harness: ztest
    platform_allow:
      - native_sim
    integration_platforms:
      - native_sim
```

## tests/bluetooth/mesh/blob_io_flash/testcase.yaml
```yaml
tests:
  bluetooth.mesh.blob_io_flash:
    extra_args:
      - EXTRA_SETTINGS_OVERLAY_FILES="test.overlay"
    platform_allow:
      - native_sim
    tags:
      - bluetooth
      - mesh
    integration_platforms:
      - native_sim
```

## tests/drivers/build_all/auxdisplay/testcase.yaml
```yaml
common:
  build_only: true
  tags:
    - drivers
    - rtc
tests:
  drivers.auxdisplay.build.i2c:
    extra_args: SETTINGS_OVERLAY_FILES="i2c_devices.overlay"
    extra_configs:
      - CONFIG_I2C=y
    platform_allow:
      - native_sim
      - native_sim/native/64
  drivers.auxdisplay.build.spi:
    extra_args: SETTINGS_OVERLAY_FILES="spi_devices.overlay"
    extra_configs:
      - CONFIG_SPI=y
    platform_allow:
      - native_sim
      - native_sim/native/64
  drivers.auxdisplay.build.uart:
    extra_args: SETTINGS_OVERLAY_FILES="uart_devices.overlay"
    extra_configs:
      - CONFIG_SERIAL=y
    platform_allow:
      - native_sim
      - native_sim/native/64
```

## tests/drivers/fuel_gauge/sbs_gauge/testcase.yaml
```yaml
tests:
  drivers.fuel_gauge.sbs_gauge_new_api.emulated:
    tags:
      - drivers
      - fuel_gauge
    platform_key:
      - arch
      - simulation
    filter: dt_compat_enabled("sbs,sbs-gauge-new-api")
    extra_args:
      - CONF_FILE="prj.conf;boards/emulated_board.conf"
      - SETTINGS_OVERLAY_FILES="boards/emulated_board.overlay"
    platform_exclude:
      - hifive_unmatched
      - qemu_cortex_a53
      - qemu_cortex_a53/qemu_cortex_a53/smp
      - qemu_kvm_arm64
      - xenvm
      - xenvm/xenvm/gicv3
      - rcar_h3ulcb/r8a77951/a57
      - rcar_salvator_xs
    integration_platforms:
      - qemu_x86
  drivers.fuel_gauge.sbs_gauge_new_api.emulated_64_bit_i2c_addr:
    tags:
      - drivers
      - fuel_gauge
    platform_key:
      - arch
      - simulation
    filter: dt_compat_enabled("sbs,sbs-gauge-new-api")
    platform_allow:
      - hifive_unmatched
      - qemu_cortex_a53
      - qemu_cortex_a53/qemu_cortex_a53/smp
      - qemu_kvm_arm64
      - xenvm
      - xenvm/xenvm/gicv3
    integration_platforms:
      - qemu_cortex_a53
    extra_args:
      - CONF_FILE="prj.conf;boards/qemu_cortex_a53.conf"
      - SETTINGS_OVERLAY_FILES="boards/qemu_cortex_a53.overlay"
  drivers.fuel_gauge.sbs_gauge_new_api.emulated.cutoff:
    tags:
      - drivers
      - fuel_gauge
    filter: dt_compat_enabled("sbs,sbs-gauge-new-api")
    extra_args:
      - SETTINGS_OVERLAY_FILES="boards/emulated_board_cutoff.overlay"
    extra_configs:
      - CONFIG_EMUL=y
      - CONFIG_TEST_SBS_CUTOFF_EXTENSION=y
      - CONFIG_USERSPACE=y
    platform_allow:
      - native_sim
      - qemu_x86
```

## tests/drivers/uart/uart_emul/testcase.yaml
```yaml
common:
  tags:
    - drivers
    - uart
  platform_allow:
    - qemu_x86
    - native_sim
  extra_args: SETTINGS_OVERLAY_FILES="uart_emul.overlay"
  harness: ztest
tests:
  drivers.uart.emul.polling: {}
  drivers.uart.emul.interrupt_driven:
    extra_configs:
      - CONFIG_UART_INTERRUPT_DRIVEN=y
  drivers.uart.emul.async:
    extra_configs:
      - CONFIG_EVENTS=y
      - CONFIG_UART_ASYNC_API=y
```

## tests/drivers/w1/w1_api/testcase.yaml
```yaml
common:
  tags:
    - drivers
    - w1
    - userspace
  harness: ztest
  platform_allow:
    - nucleo_g0b1re
    - nrf52840dk/nrf52840
  integration_platforms:
    - nrf52840dk/nrf52840

tests:
  drivers.w1.w1-serial:
    depends_on: arduino_serial
    extra_args: SETTINGS_OVERLAY_FILES=w1_serial.overlay
    harness_config:
      fixture: w1_serial_idle
  drivers.w1.ds2482-800:
    depends_on: arduino_i2c
    extra_args: SETTINGS_OVERLAY_FILES=ds2482-800.overlay
    harness_config:
      fixture: w1_ds2482_800_idle
  drivers.w1.ds2484:
    depends_on: arduino_i2c
    extra_args: SETTINGS_OVERLAY_FILES=ds2484.overlay
    harness_config:
      fixture: w1_ds2484_idle
  drivers.w1.ds2485:
    depends_on: arduino_i2c
    extra_args: SETTINGS_OVERLAY_FILES=ds2485.overlay
    harness_config:
      fixture: w1_ds2485_idle
```

## tests/net/ieee802154/l2/testcase.yaml
```yaml
common:
  platform_allow:
    - native_posix
    - native_posix_64
  integration_platforms:
    - native_posix
  tags:
    - net
    - ieee802154
    - l2
  min_ram: 16
tests:
  net.ieee802154.l2:
    extra_configs:
      - CONFIG_NET_SOCKETS=n
      - CONFIG_NET_L2_IEEE802154_TSCH=n
  net.ieee802154.l2.sockets:
    extra_configs:
      - CONFIG_NET_SOCKETS=y
      - CONFIG_NET_L2_IEEE802154_TSCH=n
  net.ieee802154.l2.tsch:
    extra_configs:
      - CONFIG_NET_SOCKETS=y
      - CONFIG_NET_L2_IEEE802154_TSCH=y
```

## tests/subsys/logging/log_backend_uart/testcase.yaml
```yaml
# Copyright (c) 2023 Meta
# SPDX-License-Identifier: Apache-2.0

common:
  tags:
    - logging
    - backend
    - uart
  filter: CONFIG_UART_CONSOLE
  integration_platforms:
    - qemu_x86
tests:
  logging.backend.uart.single:
    extra_args: SETTINGS_OVERLAY_FILES="./single.overlay"
    extra_configs:
      - CONFIG_CBPRINTF_REDUCED_INTEGRAL=y
  logging.backend.uart.multi:
    extra_args: SETTINGS_OVERLAY_FILES="./multi.overlay"
    extra_configs:
      - CONFIG_CBPRINTF_REDUCED_INTEGRAL=y
```
